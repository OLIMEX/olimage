## olimage/packages/u-boot/overlay/usr/lib/u-boot/kernel.its
```
/dts-v1/;

/ {
        description = "Simple image with single Linux kernel";
        #address-cells = <1>;

        images {
                kernel-1 {
                        description = "Linux kernel ${VERSION}";
                        data = /incbin/("./vmlinuz-${VERSION}");
                        type = "kernel";
                        arch = "{{ arch }}";
                        os = "linux";
                        compression = "gzip";
                        load = <{{ kernel.load }}>;
                        entry = <{{ kernel.entry }}>;
                        hash-1 {
                                algo = "crc32";
                        };
                        hash-2 {
                                algo = "sha1";
                        };
                };

                ramdisk-1 {
                    description = "Ramdisk for kernel ${VERSION}";
                    data = /incbin/("./initrd.img-${VERSION}");
                    type = "ramdisk";
                    arch = "{{ arch }}";
                    os = "linux";
                    load = <{{ ramdisk.load }}>;
                    entry = <{{ ramdisk.entry }}>;
                    hash-1 {
                            algo = "crc32";
                    };
                    hash-2 {
                            algo = "sha1";
                    };
                };
{% for fdt in fdts %}

                fdt-{{ loop.index }} {
{% for key,value in fdt.items() %}
                    data = /incbin/("/usr/lib/linux-image-${VERSION}/{{ key }}");
                    type = "flat_dt";
                    arch = "{{ arch }}";
                    compression = "none";
                    load = <{{ value.load }}>;
                    hash-1 {
                            algo = "crc32";
                    };
                    hash-2 {
                            algo = "sha1";
                    };
{% endfor %}
                };
{% endfor %}
{% for overlay in overlays %}

                overlay-{{ loop.index }} {
{% for key,value in overlay.items() %}
                    data = /incbin/("/usr/lib/olimex-sunxi-overlays/sun50i-a64/{{ key }}");
                    type = "flat_dt";
                    arch = "{{ arch }}";
                    compression = "none";
                    load = <{{ value.load }}>;
                    hash-1 {
                            algo = "crc32";
                    };
                    hash-2 {
                            algo = "sha1";
                    };
{% endfor %}
                };
{% endfor %}
        };

        configurations {
                default = "config-{{ default.id }}";
{% for variant in variants %}

                config-{{ variant.id }} {
                        description = "Boot Linux kernel ${VERSION} with {{ variant.name }}";
                        kernel = "kernel-1";
                        ramdisk = "ramdisk-1";
                        fdt = "fdt-{{ variant.fdt }}"{% for overlay in variant.overlays %}, "overlay-{{ overlay }}"{% endfor %};
                        compatible = "{{ variant.compatible }}";
                };
{% endfor %}
        };
};
```

## olimage/rootfs/overlay/boot/kernel.its
```
/dts-v1/;

/ {
        description = "Simple image with single Linux kernel";
        #address-cells = <1>;

        images {
                kernel {
                        description = "Vanilla Linux kernel";
                        data = /incbin/("./vmlinuz-5.3.1-1-olimex");
                        type = "kernel";
                        arch = "arm64";
                        os = "linux";
                        compression = "gzip";
                        load = <0x40080000>;
                        entry = <0x40080000>;
                        hash-1 {
                                algo = "crc32";
                        };
                        hash-2 {
                                algo = "sha1";
                        };
                };

                ramdisk {
                    description = "Kernel ramdisk";
                    data = /incbin/("./initrd.img-5.3.1-1-olimex");
                    type = "ramdisk";
                    arch = "arm64";
                    os = "linux";
                    compression = "gzip";
                    load = <0x4FE00000>;
                    entry = <0x4FE00000>;
                    hash-1 {
                            algo = "crc32";
                    };
                    hash-2 {
                            algo = "sha1";
                    };
                };

                fdt {
                    description = "fts";
                    data = /incbin/("./sun50i-a64-olinuxino.dtb");
                    type = "flat_dt";
                    arch = "arm64";
                    compression = "none";
                    hash-1 {
                            algo = "crc32";
                    };
                    hash-2 {
                            algo = "sha1";
                    };
                };
        };

        configurations {
                default = "config-1";
                config-1 {
                        description = "Boot Linux kernel";
                        kernel = "kernel";
                        fdt = "fdt";
                        ramdisk = "ramdisk";
                };
        };
};
```
